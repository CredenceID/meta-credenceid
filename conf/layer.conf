## conf/layer.conf
```bitbake
# We have a conf and classes directory, append to BBPATH
BBPATH .= ":${LAYERDIR}"

# We have a packages directory, add to BBFILES
BBFILES += "${LAYERDIR}/recipes-*/*/*.bb \
            ${LAYERDIR}/recipes-*/*/*.bbappend"

BBFILE_COLLECTIONS += "meta-credenceid"
BBFILE_PATTERN_meta-credenceid := "^${LAYERDIR}/"
LAYERSERIES_COMPAT_meta-credenceid = "mickledore"


HOSTTOOLS_NONFATAL += "free"
```
